## board/samsung/mini2440/Kconfig
```kconfig
if TARGET_MINI2440

config SYS_BOARD
	default "mini2440"

config SYS_VENDOR
	default "samsung"

config SYS_SOC
	default "s3c24x0"

config SYS_CONFIG_NAME
	default "mini2440"

endif
```

## configs/mini2440_defconfig
```kconfig
CONFIG_ARM=y
CONFIG_TARGET_MINI2440=y
CONFIG_SYS_PROMPT="MINI2440 # "
# CONFIG_CMD_SETEXPR is not set
```
